## boards/shields/miiunic/Kconfig.shield
```kconfig
config SHIELD_MIIUNIC_LEFT
    def_bool $(shields_list_contains,miiunic_left)
  
config SHIELD_MIIUNIC_RIGHT
    def_bool $(shields_list_contains,miiunic_right)
  
config SHIELD_MIIUNIC_DONGLE
    def_bool $(shields_list_contains,miiunic_dongle)
```
